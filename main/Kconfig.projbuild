## main/Kconfig.projbuild
```kconfig
menu "Device Configuration"

    orsource "$IDF_PATH/examples/common_components/env_caps/$IDF_TARGET/Kconfig.env_caps"

    config DEVICE_DOORBELL_PIN
        int "Doorbell pin"
        default -1

endmenu
```

## sdkconfig.defaults
```kconfig
# Application configuration

CONFIG_DEVICE_DOORBELL_PIN=12

CONFIG_IDF_TARGET="esp32s3"

# Setup flash

CONFIG_ESPTOOLPY_FLASHSIZE_4MB=y
CONFIG_PARTITION_TABLE_CUSTOM=y

# SPIRAM

CONFIG_SPIRAM=y
CONFIG_SPIRAM_FETCH_INSTRUCTIONS=y
CONFIG_SPIRAM_RODATA=y
CONFIG_SPIRAM_SPEED_80M=y

# Status led

CONFIG_STATUS_LED_WS2812_PIN=38

# MQTT

CONFIG_MQTT_TOPIC_PREFIX="doorbell_receiver"
CONFIG_MQTT_DEVICE_MANUFACTURER="Pieter"
CONFIG_MQTT_DEVICE_MODEL="Doorbell Receiver"
CONFIG_MQTT_DEVICE_MODEL_ID="Doorbell Receiver v1"
```
